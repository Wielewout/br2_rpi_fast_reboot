## Config.in
```kconfig
menu "DistriNet"
	source "$BR2_EXTERNAL_RPI_FAST_REBOOT_PATH/package/Config.in"
endmenu
```

## configs/rpi0w_fast_reboot_defconfig
```kconfig
BR2_arm=y
BR2_arm1176jzf_s=y
BR2_ARM_EABIHF=y

# Linux headers same as kernel, a 5.10 series
BR2_PACKAGE_HOST_LINUX_HEADERS_CUSTOM_5_10=y

BR2_TOOLCHAIN_BUILDROOT_CXX=y
BR2_TOOLCHAIN_BUILDROOT_GLIBC=y

BR2_LINUX_KERNEL=y
BR2_LINUX_KERNEL_CUSTOM_TARBALL=y
BR2_LINUX_KERNEL_CUSTOM_TARBALL_LOCATION="$(call github,raspberrypi,linux,967d45b29ca2902f031b867809d72e3b3d623e7a)/linux-967d45b29ca2902f031b867809d72e3b3d623e7a.tar.gz"
BR2_LINUX_KERNEL_USE_CUSTOM_CONFIG=y
BR2_LINUX_KERNEL_CUSTOM_CONFIG_FILE="$(BR2_EXTERNAL_RPI_FAST_REBOOT_PATH)/board/distrinet/rpi0w-localizer/linux/linux.min.config"
BR2_LINUX_KERNEL_LZ4=y
BR2_LINUX_KERNEL_APPENDED_ZIMAGE=y
BR2_LINUX_KERNEL_INTREE_DTS_NAME="rpi0w"
BR2_LINUX_KERNEL_CUSTOM_DTS_PATH="$(BR2_EXTERNAL_RPI_FAST_REBOOT_PATH)/board/distrinet/rpi0w-localizer/dts/rpi0w.dts"
BR2_LINUX_KERNEL_NEEDS_HOST_OPENSSL=y

BR2_TARGET_GENERIC_HOSTNAME="rpi"
BR2_TARGET_GENERIC_ISSUE="Welcome to Raspberry Pi!"
# BR2_TARGET_GENERIC_GETTY is not set

BR2_PACKAGE_BUSYBOX_CONFIG_FRAGMENT_FILES="$(BR2_EXTERNAL_RPI_FAST_REBOOT_PATH)/board/distrinet/rpi0w-localizer/busybox/busybox.pkill.config"

# Packages
BR2_PACKAGE_RPI_FIRMWARE=y
BR2_PACKAGE_RPI_FIRMWARE_X=y

BR2_PACKAGE_RPI_CONFIG=y
BR2_PACKAGE_RPI_CONFIG_MINIMAL=y
BR2_PACKAGE_RPI_CONFIG_KERNEL="zImage.rpi0w"
BR2_PACKAGE_RPI_CONFIG_DISABLE_SPLASH=y
BR2_PACKAGE_RPI_CONFIG_DEVICE_TREE=y

BR2_PACKAGE_RPI_CMDLINE=y
BR2_PACKAGE_RPI_CMDLINE_TXT="8250.nr_uarts=1 root=/dev/mmcblk0p2 rootfstype=erofs rootwait console=tty1 lpj=3489792"

BR2_PACKAGE_RPI_USERLAND=y

BR2_PACKAGE_SHUTDOWNCHECK=y
BR2_PACKAGE_BOOT_MEASUREMENTS=y
BR2_PACKAGE_PERIODIC_MEASUREMENTS=y
BR2_PACKAGE_RPI_LOCALIZER=y

# BR2_PACKAGE_IFUPDOWN_SCRIPTS is not set

# Required tools to create the SD image
BR2_PACKAGE_HOST_DOSFSTOOLS=y
BR2_PACKAGE_HOST_E2FSPROGS=y
BR2_PACKAGE_HOST_GENIMAGE=y
BR2_PACKAGE_HOST_MTOOLS=y

# Filesystem / image
BR2_TARGET_ROOTFS_EROFS=y
# BR2_TARGET_ROOTFS_TAR is not set
BR2_ROOTFS_POST_BUILD_SCRIPT="$(BR2_EXTERNAL_RPI_FAST_REBOOT_PATH)/board/distrinet/rpi0w-localizer/post-build.sh"
BR2_ROOTFS_POST_IMAGE_SCRIPT="$(BR2_EXTERNAL_RPI_FAST_REBOOT_PATH)/board/distrinet/rpi0w-localizer/post-image.sh"
BR2_ROOTFS_POST_SCRIPT_ARGS=""
```

## package/Config.in
```kconfig
menu "Localizer"
	source "$BR2_EXTERNAL_RPI_FAST_REBOOT_PATH/package/rpi-localizer/Config.in"
endmenu

menu "Measurements"
	source "$BR2_EXTERNAL_RPI_FAST_REBOOT_PATH/package/shutdowncheck/Config.in"
	source "$BR2_EXTERNAL_RPI_FAST_REBOOT_PATH/package/boot-measurements/Config.in"
	source "$BR2_EXTERNAL_RPI_FAST_REBOOT_PATH/package/periodic-measurements/Config.in"
endmenu

menu "Configuration"
	source "$BR2_EXTERNAL_RPI_FAST_REBOOT_PATH/package/rpi-config/Config.in"
	source "$BR2_EXTERNAL_RPI_FAST_REBOOT_PATH/package/rpi-cmdline/Config.in"
endmenu
```

## package/boot-measurements/Config.in
```kconfig
config BR2_PACKAGE_BOOT_MEASUREMENTS
	bool "boot-measurements"
	depends on BR2_PACKAGE_SHUTDOWNCHECK
	depends on BR2_PACKAGE_RPI_FIRMWARE
	help
	  This is a package that is used to retrieve boot
	  measurements from the Sleepy Pi 2, or to clear
	  all previous measurements.

comment "boot-measurements depends on rpi-firmware and shutdowncheck"
	depends on !BR2_PACKAGE_SHUTDOWNCHECK \
		|| !(BR2_PACKAGE_RPI_FIRMWARE)
```

## package/periodic-measurements/Config.in
```kconfig
config BR2_PACKAGE_PERIODIC_MEASUREMENTS
	bool "periodic-measurements"
	depends on BR2_PACKAGE_SHUTDOWNCHECK
	depends on BR2_PACKAGE_RPI_LOCALIZER
	help
	  This is a package that is used for periodic
	  measurements using the Sleepy Pi 2 and
	  localizer application as load.
	  Add pkill in the busybox configuration!

comment "periodic-measurements depends on rpi-localizer and shutdowncheck"
	depends on !BR2_PACKAGE_SHUTDOWNCHECK \
		|| !BR2_PACKAGE_RPI_LOCALIZER

config BR2_PACKAGE_PERIODIC_MEASUREMENTS_TYPE
	string "periodic-measurements type"
	default "shut"
	depends on BR2_PACKAGE_PERIODIC_MEASUREMENTS
	help
	  The type for the periodic measurements
	  (type=shut|idle).
```

## package/rpi-cmdline/Config.in
```kconfig
config BR2_PACKAGE_RPI_CMDLINE
	bool "rpi-cmdline"
	depends on BR2_PACKAGE_RPI_FIRMWARE
	help
	  This is a package that is used to alter the
	  cmdline.txt file from rpi-firmware.

comment "rpi-cmdline depends on rpi-firmware"
	depends on !BR2_PACKAGE_RPI_FIRMWARE

config BR2_PACKAGE_RPI_CMDLINE_TXT
	string "cmdline.txt"
	default "root=/dev/mmcblk0p2 rootwait console=tty1 console=ttyAMA0,115200"
	depends on BR2_PACKAGE_RPI_CMDLINE
	help
	  The text to put in cmdline.txt.
```

## package/rpi-config/Config.in
```kconfig
menuconfig BR2_PACKAGE_RPI_CONFIG
	bool "rpi-config"
	depends on BR2_PACKAGE_RPI_FIRMWARE
	help
	  This is a package that is used to alter the
	  config.txt file from rpi-firmware.

if BR2_PACKAGE_RPI_CONFIG

config BR2_PACKAGE_RPI_CONFIG_MINIMAL
	bool "minimal config file"
	depends on BR2_PACKAGE_RPI_CONFIG
	help
	  Minimize the config.txt file by
	  removing blank lines and comments.

menu "Memory"

config BR2_PACKAGE_RPI_CONFIG_GPU_MEM
	bool "gpu mem"
	depends on BR2_PACKAGE_RPI_CONFIG
	help
	  Enable to set GPU memory (gpu_mem=64).

config BR2_PACKAGE_RPI_CONFIG_GPU_MEM_VALUE
	int "gpu mem value"
	depends on BR2_PACKAGE_RPI_CONFIG
	depends on BR2_PACKAGE_RPI_CONFIG_GPU_MEM
	help
	  GPU memory (gpu_mem=64).

config BR2_PACKAGE_RPI_CONFIG_GPU_MEM_256
	int "gpu mem 256"
	default 100
	depends on BR2_PACKAGE_RPI_CONFIG
	help
	  GPU memory with 256 MB total memory
	  (gpu_mem_256=100).

config BR2_PACKAGE_RPI_CONFIG_GPU_MEM_512
	int "gpu mem 512"
	default 100
	depends on BR2_PACKAGE_RPI_CONFIG
	help
	  GPU memory with 512 MB total memory
	  (gpu_mem_512=100).

config BR2_PACKAGE_RPI_CONFIG_GPU_MEM_1024
	int "gpu mem 1024"
	default 100
	depends on BR2_PACKAGE_RPI_CONFIG
	help
	  GPU memory with 1024 MB or more
	  total memory (gpu_mem_1024=100).

config BR2_PACKAGE_RPI_CONFIG_TOTAL_MEM
	bool "total mem"
	depends on BR2_PACKAGE_RPI_CONFIG
	help
	  Enable to set the total memory
	  to limit the board to (total_mem=1024).

config BR2_PACKAGE_RPI_CONFIG_TOTAL_MEM_VALUE
	int "total mem value"
	depends on BR2_PACKAGE_RPI_CONFIG
	depends on BR2_PACKAGE_RPI_CONFIG_TOTAL_MEM
	help
	  Total memory to limit the board to
	  (total_mem=1024).

config BR2_PACKAGE_RPI_CONFIG_DISABLE_L2CACHE
	bool "disable l2cache"
	depends on BR2_PACKAGE_RPI_CONFIG
	help
	  Disable l2cache (disable_l2cache=1).

endmenu # Memory

menu "License Keys/Codec"

config BR2_PACKAGE_RPI_CONFIG_DECODE_MPG2
	string "decode mpg2"
	depends on BR2_PACKAGE_RPI_CONFIG
	help
	  License key to decode mpg2
	  (decode_MPG2=0x12345678).

config BR2_PACKAGE_RPI_CONFIG_DECODE_WVC1
	string "decode wvc1"
	depends on BR2_PACKAGE_RPI_CONFIG
	help
	  License key to decode wvc1
	  (decode_WVC1=0x12345678).

endmenu # License Keys/Codec

menu "Video/Display"

config BR2_PACKAGE_RPI_CONFIG_HDMI_SAFE
	bool "hdmi safe"
	depends on BR2_PACKAGE_RPI_CONFIG
	help
	  HDMI safe (hdmi_safe=1).

config BR2_PACKAGE_RPI_CONFIG_DISABLE_OVERSCAN
	bool "disable overscan"
	default y
	depends on BR2_PACKAGE_RPI_CONFIG
	help
	  Disable overscan (disable_overscan=1).

endmenu # Video/Display

menu "Audio"

endmenu # Audio

menu "Camera"

config BR2_PACKAGE_RPI_CONFIG_DISABLE_CAMERA_LED
	bool "disable camera led"
	depends on BR2_PACKAGE_RPI_CONFIG
	help
	  Disable camera LED (disable_camera_led=1).

endmenu # Camera

menu "Boot"

config BR2_PACKAGE_RPI_CONFIG_START_FILE
	string "start file"
	default "start.elf"
	depends on BR2_PACKAGE_RPI_CONFIG
	help
	  Start file (start_file=start.elf).

config BR2_PACKAGE_RPI_CONFIG_FIXUP_FILE
	string "fixup file"
	default "fixup.dat"
	depends on BR2_PACKAGE_RPI_CONFIG
	help
	  Fixup file (fixup_file=fixup.dat).

config BR2_PACKAGE_RPI_CONFIG_DISABLE_COMMANDLINE_TAGS
	bool "disable commandline tags"
	depends on BR2_PACKAGE_RPI_CONFIG
	help
	  Disable commandline tags (disable_commandline_tags=1).

config BR2_PACKAGE_RPI_CONFIG_CMDLINE
	string "cmdline"
	depends on BR2_PACKAGE_RPI_CONFIG
	help
	  Cmdline text file (cmdline=cmdline.txt).

config BR2_PACKAGE_RPI_CONFIG_KERNEL
	string "kernel"
	default "zImage"
	depends on BR2_PACKAGE_RPI_CONFIG
	help
	  Kernel image file (kernel=zImage).

config BR2_PACKAGE_RPI_CONFIG_ARM_64BIT
	bool "arm 64-bit"
	depends on BR2_PACKAGE_RPI_CONFIG
	help
	  ARM 64-bit (arm_64bit=1).

config BR2_PACKAGE_RPI_CONFIG_ARMSTUB
	string "arm stub"
	depends on BR2_PACKAGE_RPI_CONFIG
	help
	  ARM stub (armstub=armstub.S).

config BR2_PACKAGE_RPI_CONFIG_BOOTCODE_DELAY
	int "bootcode delay"
	default 0
	depends on BR2_PACKAGE_RPI_CONFIG
	help
	  Bootcode delay in seconds (bootcode_delay=0).

config BR2_PACKAGE_RPI_CONFIG_BOOT_DELAY
	int "boot delay"
	default 0
	depends on BR2_PACKAGE_RPI_CONFIG
	help
	  Boot delay in seconds (boot_delay=1).

config BR2_PACKAGE_RPI_CONFIG_BOOT_DELAY_MS
	int "boot delay ms"
	default 0
	depends on BR2_PACKAGE_RPI_CONFIG
	help
	  Boot delay in milliseconds (boot_delay_ms=0).

config BR2_PACKAGE_RPI_CONFIG_DISABLE_SPLASH
	bool "disable splash"
	depends on BR2_PACKAGE_RPI_CONFIG
	help
	  Disable rainbow splash screen (disable_splash=1).

endmenu # Boot

menu "Ports and device tree"

config BR2_PACKAGE_RPI_CONFIG_DEVICE_TREE
	bool "device tree"
	depends on BR2_PACKAGE_RPI_CONFIG
	help
	  Use a specific device tree (device_tree=bcm2708-rpi-zero-w.dtb).

config BR2_PACKAGE_RPI_CONFIG_DEVICE_TREE_NAME
	string "device tree name"
	depends on BR2_PACKAGE_RPI_CONFIG_DEVICE_TREE
	help
	  Specific device tree name (device_tree=bcm2708-rpi-zero-w.dtb).

config BR2_PACKAGE_RPI_CONFIG_ENABLE_UART
	bool "enable uart"
	depends on BR2_PACKAGE_RPI_CONFIG
	help
	  Enable uart (enable_uart=1).

endmenu # Ports and device tree

menu "GPIOs"

endmenu # GPIOs

menuconfig BR2_PACKAGE_RPI_CONFIG_OVERCLOCK
	bool "Overclocking"
	depends on BR2_PACKAGE_RPI_CONFIG
	help
	  Enable overclocking configuration.

if BR2_PACKAGE_RPI_CONFIG_OVERCLOCK

config BR2_PACKAGE_RPI_CONFIG_INITIAL_TURBO
	bool "initial turbo"
	depends on BR2_PACKAGE_RPI_CONFIG
	depends on BR2_PACKAGE_RPI_CONFIG_OVERCLOCK
	help
	  Initial turbo (initial_turbo=1).

config BR2_PACKAGE_RPI_CONFIG_FORCE_TURBO
	bool "force turbo"
	depends on BR2_PACKAGE_RPI_CONFIG
	depends on BR2_PACKAGE_RPI_CONFIG_OVERCLOCK
	help
	  Force turbo (force_turbo=1).

config BR2_PACKAGE_RPI_CONFIG_OVER_VOLTAGE
	bool "over voltage"
	depends on BR2_PACKAGE_RPI_CONFIG
	depends on BR2_PACKAGE_RPI_CONFIG_OVERCLOCK
	help
	  Enable to set over voltage (over_voltage=0).

config BR2_PACKAGE_RPI_CONFIG_OVER_VOLTAGE_VALUE
	int "over voltage value"
	depends on BR2_PACKAGE_RPI_CONFIG
	depends on BR2_PACKAGE_RPI_CONFIG_OVERCLOCK
	depends on BR2_PACKAGE_RPI_CONFIG_OVER_VOLTAGE
	help
	  Over voltage (over_voltage=0).

config BR2_PACKAGE_RPI_CONFIG_ARM_FREQ
	bool "arm freq"
	depends on BR2_PACKAGE_RPI_CONFIG
	depends on BR2_PACKAGE_RPI_CONFIG_OVERCLOCK
	help
	  Enable to set arm frequency (arm_freq=0).

config BR2_PACKAGE_RPI_CONFIG_ARM_FREQ_VALUE
	int "arm freq value"
	depends on BR2_PACKAGE_RPI_CONFIG
	depends on BR2_PACKAGE_RPI_CONFIG_OVERCLOCK
	depends on BR2_PACKAGE_RPI_CONFIG_ARM_FREQ
	help
	  Arm frequency (arm_freq=0).

config BR2_PACKAGE_RPI_CONFIG_CORE_FREQ
	bool "core freq"
	depends on BR2_PACKAGE_RPI_CONFIG
	depends on BR2_PACKAGE_RPI_CONFIG_OVERCLOCK
	help
	  Enable to set core frequency (core_freq=0).

config BR2_PACKAGE_RPI_CONFIG_CORE_FREQ_VALUE
	int "core freq value"
	depends on BR2_PACKAGE_RPI_CONFIG
	depends on BR2_PACKAGE_RPI_CONFIG_OVERCLOCK
	depends on BR2_PACKAGE_RPI_CONFIG_CORE_FREQ
	help
	  Core frequency (core_freq=0).

config BR2_PACKAGE_RPI_CONFIG_SDRAM_FREQ
	bool "sdram freq"
	depends on BR2_PACKAGE_RPI_CONFIG
	depends on BR2_PACKAGE_RPI_CONFIG_OVERCLOCK
	help
	  Set to enable SDRAM frequency (sdram_freq=0).

config BR2_PACKAGE_RPI_CONFIG_SDRAM_FREQ_VALUE
	int "sdram freq value"
	depends on BR2_PACKAGE_RPI_CONFIG
	depends on BR2_PACKAGE_RPI_CONFIG_OVERCLOCK
	depends on BR2_PACKAGE_RPI_CONFIG_SDRAM_FREQ
	help
	  SDRAM frequency (sdram_freq=0).

endif # Overclocking

menu "Miscelaneous"

config BR2_PACKAGE_RPI_CONFIG_AVOID_WARNINGS
	bool "avoid warnings"
	depends on BR2_PACKAGE_RPI_CONFIG
	help
	  Enable to set avoid warnings (avoid_warnings=1).

config BR2_PACKAGE_RPI_CONFIG_AVOID_WARNINGS_VALUE
	int "avoid warnings value"
	depends on BR2_PACKAGE_RPI_CONFIG
	depends on BR2_PACKAGE_RPI_CONFIG_AVOID_WARNINGS
	help
	  Avoid warnings (avoid_warnings=1).

config BR2_PACKAGE_RPI_CONFIG_LOGGING_LEVEL
	bool "logging level"
	depends on BR2_PACKAGE_RPI_CONFIG
	help
	  Enable to set VideoCore logging level (logging_level=1).

config BR2_PACKAGE_RPI_CONFIG_LOGGING_LEVEL_VALUE
	int "logging level value"
	depends on BR2_PACKAGE_RPI_CONFIG
	depends on BR2_PACKAGE_RPI_CONFIG_LOGGING_LEVEL
	help
	  VideoCore logging level (logging_level=1).

endmenu # Miscelaneous

endif # BR2_PACKAGE_RPI_CONFIG

comment "rpi-config depends on rpi-firmware"
	depends on !BR2_PACKAGE_RPI_FIRMWARE
```

## package/rpi-localizer/Config.in
```kconfig
config BR2_PACKAGE_RPI_LOCALIZER
	bool "rpi-localizer"
	depends on BR2_TOOLCHAIN_BUILDROOT_GLIBC
	depends on BR2_PACKAGE_RPI_FIRMWARE
	depends on BR2_PACKAGE_RPI_FIRMWARE_X
	depends on BR2_PACKAGE_RPI_USERLAND
	help
	  This is a package to localize vehicles with the
	  Raspberry Pi Camera and a Zero W with Sleepy Pi 2.

comment "rpi-localizer needs a toolchain w/ glibc"
	depends on !BR2_TOOLCHAIN_BUILDROOT_GLIBC

comment "rpi-localizer depends on extended rpi-firmware"
	depends on !BR2_PACKAGE_RPI_FIRMWARE || !BR2_PACKAGE_RPI_FIRMWARE_X

comment "rpi-localizer depends on rpi-userland"
	depends on !BR2_PACKAGE_RPI_USERLAND
```

## package/shutdowncheck/Config.in
```kconfig
config BR2_PACKAGE_SHUTDOWNCHECK
	bool "shutdowncheck"
	help
	  This is a package to measure boot times of a
	  Raspberry Pi with Sleepy Pi 2. It will indicate the
	  RPi is running and check if it should shut down.
	  
	  Measurement software for the Sleepy Pi 2 is included
	  in the sleepypi2 board folder.
```
